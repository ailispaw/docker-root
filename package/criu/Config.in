## package/criu/Config.in
```kconfig
config BR2_PACKAGE_CRIU
	bool "criu"
	depends on BR2_TOOLCHAIN_USES_GLIBC
	depends on BR2_PACKAGE_PROTOBUF_C
	help
	  Checkpoint/Restore In Userspace

	  https://criu.org/

comment "criu needs an (e)glibc toolchain"
	depends on !BR2_TOOLCHAIN_USES_GLIBC
```

## package/protobuf-c/Config.in
```kconfig
config BR2_PACKAGE_PROTOBUF_C
	bool "protobuf-c"
	depends on BR2_TOOLCHAIN_USES_GLIBC
	depends on BR2_TOOLCHAIN_HAS_THREADS
	# host-protobuf only builds on certain architectures
	depends on BR2_HOSTARCH = "x86_64" || BR2_HOSTARCH = "x86"
	help
	  Code generator and runtime libraries to use Protocol Buffers
	  from pure C (not C++).

	  http://code.google.com/p/protobuf-c/

comment "protobuf-c an (e)glibc toolchain w/ threads"
	depends on !BR2_TOOLCHAIN_USES_GLIBC || !BR2_TOOLCHAIN_HAS_THREADS
	depends on BR2_HOSTARCH = "x86_64" || BR2_HOSTARCH = "x86"
```
